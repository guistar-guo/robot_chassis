/**
  ******************************************************************************
  * File Name          : aqmd.c
  * Description        : 爱思控485驱动
	* @author            : 天科大-机器人实验室-郭耀辉
  ******************************************************************************
  * @attention
  *
  * 本文件的协议解析是作者目前为止写过最复杂的！另外注意，目前板载的串口资源
	*	已经不够aqmd模块使用了，将代码加进工程只是为了后续改进ros通讯协议的时候作为
	* 参考，爱思控的协议参考：附件/通讯协议/AQMD6010BLS-Ex_UM_V0.90.pdf
  *
  ******************************************************************************
  */

#include "aqmd.h"

uint8_t GLOBLE_ADR;								//本次从站地址
uint8_t GLOBLE_READ_REG = READ_HOLD_REGISTER;								//本次接收校验寄存器
uint8_t aqmd_rec_buf[100];				//接收缓冲
uint8_t aqmd_rec_cur_cnt;					//记录接收缓冲区的有效数据个数
uint16_t rec_data;								//记录接收到的数据
uint16_t rec_data_crc;						//记录接收到的数据的crc校验值

uint16_t rec_send_reg;						//用于指示本次stm32给从机发送的寄存器
uint16_t rec_send_data;						//用于指示本次stm32给从机发送的数据

/* 高位字节的CRC 值*/ 
static unsigned char auchCRCHi[] = { 
 0x00, 0xC1, 0x81, 0x40, 0x01, 0xC0, 0x80, 0x41, 0x01, 0xC0, 0x80, 0x41, 0x00, 0xC1, 0x81, 
 0x40, 0x01, 0xC0, 0x80, 0x41, 0x00, 0xC1, 0x81, 0x40, 0x00, 0xC1, 0x81, 0x40, 0x01, 0xC0, 
 0x80, 0x41, 0x01, 0xC0, 0x80, 0x41, 0x00, 0xC1, 0x81, 0x40, 0x00, 0xC1, 0x81, 0x40, 0x01, 
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 0x00, 0xC1, 0x81, 0x40, 0x01, 0xC0, 0x80, 0x41, 0x01, 0xC0, 0x80, 0x41, 0x00, 0xC1, 0x81, 
 0x40 
} ; 
/* 低位字节的CRC 值*/ 
static char auchCRCLo[] = { 
 0x00, 0xC0, 0xC1, 0x01, 0xC3, 0x03, 0x02, 0xC2, 0xC6, 0x06, 0x07, 0xC7, 0x05, 0xC5, 0xC4, 
 0x04, 0xCC, 0x0C, 0x0D, 0xCD, 0x0F, 0xCF, 0xCE, 0x0E, 0x0A, 0xCA, 0xCB, 0x0B, 0xC9, 0x09, 
 0x08, 0xC8, 0xD8, 0x18, 0x19, 0xD9, 0x1B, 0xDB, 0xDA, 0x1A, 0x1E, 0xDE, 0xDF, 0x1F, 0xDD, 
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 0x44, 0x84, 0x85, 0x45, 0x87, 0x47, 0x46, 0x86, 0x82, 0x42, 0x43, 0x83, 0x41, 0x81, 0x80, 
 0x40 
};

/**************************************************************************
函数功能：crc校验函数
入口参数：puchMsg：报头指针		usDataLen：报文长度
返回  值：crc校验结果
**************************************************************************/
static uint16_t CRC16(uint8_t *puchMsg, uint8_t usDataLen)
{      /* 函数以unsigned short 类型返回CRC */ 
 unsigned char uchCRCHi = 0xFF;   /* CRC 的高字节初始化*/ 
 unsigned char uchCRCLo = 0xFF;   /* CRC 的低字节初始化*/ 
 unsigned uIndex ;      /* CRC 查询表索引*/ 
 
 while (usDataLen--)      /* 完成整个报文缓冲区*/ 
 { 
  uIndex = uchCRCLo ^ *puchMsg++; /* 计算CRC */ 
  uchCRCLo = uchCRCHi ^ auchCRCHi[uIndex]; 
  uchCRCHi = auchCRCLo[uIndex]; 
 } 
 return (uchCRCHi << 8 | uchCRCLo); 
}

/**************************************************************************
函数功能：向485总线发送若干个字节
入口参数：略
返回  值：略
**************************************************************************/
static void aqmd_send_bytes(uint8_t * start, uint8_t size){
	HAL_UART_Transmit(&huart4, start, size, HAL_MAX_DELAY);
}

AqmdDataStateTypeDef aqmdDataState = undecided;
/**************************************************************************
函数功能：接收单个字节的回调函数
入口参数：本次接收到的字节
返回  值：无
**************************************************************************/
void aqmd_receive_one_byte_callback(uint8_t recByte){
		while(1){
			aqmd_rec_buf[aqmd_rec_cur_cnt] = recByte;
			if(aqmd_rec_cur_cnt == 0 && aqmd_rec_buf[0] != GLOBLE_ADR){//帧头不对，丢掉
				aqmdDataState = dataError;
				break;
			}
			aqmd_rec_cur_cnt++;
			
			if(GLOBLE_READ_REG == READ_HOLD_REGISTER){//如果是写保持寄存器
					if(aqmd_rec_cur_cnt == 2 && aqmd_rec_buf[1] != READ_HOLD_REGISTER){//异常码
						aqmdDataState = dataError;
						aqmd_rec_cur_cnt = 0;//重新开始读取
						break;
					}else if(aqmd_rec_cur_cnt == 2 && aqmd_rec_buf[1] == READ_HOLD_REGISTER){//未定码(因为还没有crc校验)
						aqmdDataState = undecided;
						break;
					}
					
					//计算crc校验值
					rec_data_crc = CRC16(aqmd_rec_buf, 5);
					if(aqmd_rec_cur_cnt == 7){
						if(((aqmd_rec_buf[6]<<8)|aqmd_rec_buf[5]) == rec_data_crc){//成功接收到一帧数据
							rec_data = (aqmd_rec_buf[3] << 8)|(aqmd_rec_buf[3]);//记录读取到的数据
							aqmdDataState = correct;//标记成功读取到了一帧数据
							aqmd_rec_cur_cnt = 0;//重新开始读取
						}else{//crc校验错误
							aqmdDataState = dataError;
							aqmd_rec_cur_cnt = 0;//重新开始读取
						}
						break;
					}
			}
			else if(GLOBLE_READ_REG == WRITE_SINGLE_REGISTER){//如果是写寄存器操作返回的数据
				if(aqmd_rec_cur_cnt == 2 && aqmd_rec_buf[1] != WRITE_SINGLE_REGISTER){//异常码
						aqmdDataState = dataError;
						aqmd_rec_cur_cnt = 0;//重新开始读取
						break;
				}else if(aqmd_rec_cur_cnt == 2 && aqmd_rec_buf[1] == WRITE_SINGLE_REGISTER){//未定码(因为还没有crc校验)
						aqmdDataState = undecided;
						break;
				}
				
				rec_data_crc = CRC16(aqmd_rec_buf, 6);//计算当前收到的所有数据的crc校验结果
				if(aqmd_rec_cur_cnt == 8){
					if(((aqmd_rec_buf[7]<<8)|aqmd_rec_buf[6]) == rec_data_crc){//成功接收到一帧数据
							rec_send_reg = ((aqmd_rec_buf[2]<<8)|aqmd_rec_buf[3]);//记录本次的寄存器地址
							rec_send_data = ((aqmd_rec_buf[4]<<8)|aqmd_rec_buf[5]);//记录本次的寄存器值
							aqmdDataState = correct;//标记成功读取到了一帧数据
							aqmd_rec_cur_cnt = 0;//重新开始读取
						}else{//crc校验错误
							aqmdDataState = dataError;
							aqmd_rec_cur_cnt = 0;//重新开始读取
						}
						break;
				}
			}
			break;
		}
}

//以下是一个标准的从站回送单字节的数据帧供测试程序使用
uint8_t test_rec[7]={0x00, 0x03, 0x03, 0x02, 0x03, 0x95, 0x25};

/**************************************************************************
函数功能：读取一个寄存器的数据
入口参数：ADR  从机地址	； addr 要读取的从机寄存器地址
返回  值：读取到的数据，错误码-1
**************************************************************************/
int aqmd_read_reg(uint8_t ADR, uint16_t addr){
	GLOBLE_ADR = ADR;
	GLOBLE_READ_REG = READ_HOLD_REGISTER;
	uint8_t send_temp[8] = {ADR, READ_HOLD_REGISTER, ((0Xff00 & addr)>>8), (0x00ff & addr), 0x00, 0x01, 0xff, 0xff};
	uint16_t send_data_crc_check = CRC16(send_temp, 6);
	send_temp[6] = (0x00ff & send_data_crc_check);
	send_temp[7] = ((0xff00 & send_data_crc_check)>>8);
	aqmd_send_bytes(send_temp, 8);
	uint16_t timeout = 0xffff;
	while(aqmdDataState != correct && timeout--){}
	aqmdDataState = undecided;//准备接收下一个字节
	return aqmdDataState == correct ? rec_data : -1;	
}

/**************************************************************************
函数功能：给爱思控的一个寄存器发送一个字节的数据
入口参数：ADR  从机地址	； addr 要写的从机寄存器地址；	data	要写的数据
返回  值：无
**************************************************************************/
void aqmd_send_one_byte_to_reg(uint8_t ADR, uint16_t addr, uint16_t data){
	GLOBLE_ADR = ADR;
	GLOBLE_READ_REG = WRITE_SINGLE_REGISTER;
	uint8_t send_temp[8] = {ADR, WRITE_SINGLE_REGISTER, ((0Xff00 & addr)>>8),\
	(0x00ff & addr), ((0Xff00 & data)>>8), (0x00ff & data), 0xff, 0xff};
	uint16_t send_data_crc_check = CRC16(send_temp, 6);
	send_temp[6] = (0x00ff & send_data_crc_check);
	send_temp[7] = ((0xff00 & send_data_crc_check)>>8);
	aqmd_send_bytes(send_temp, 8);
}

/**************************************************************************
函数功能：设置指定爱思控的pwm占空比
入口参数：ADR  从机地址	； pwm	输入范围-1000到1000，即占空比等于pwm*0.1
返回  值：无
**************************************************************************/
void aqmd_set_pwm(uint8_t ADR, short pwm){
	aqmd_send_one_byte_to_reg(ADR, REG_SET_PWM, pwm);
}

/**************************************************************************
函数功能：打印调试信息
入口参数：无
返回  值：无
**************************************************************************/
void aqmd_debug_log(void){
		for (int i = 0; i<10; i++){
			rtos_printf("0x%x ", aqmd_rec_buf[i]);
		}
		rtos_printf("\r\n");
		
		switch(aqmdDataState){
			case undecided:
				rtos_printf("undecided\r\n");
				break;
			case dataError:
				rtos_printf("dataError\r\n");
				break;
			case correct:
				rtos_printf("correct\r\n");
				break;
		}
		
		osDelay(200);
}

//测试使用
void aqmd_test(void){
	while(1){
		aqmd_set_pwm(0x01, 500);
		osDelay(2000);
		aqmd_set_pwm(0x01, 0);
		osDelay(500);
		aqmd_set_pwm(0x01, -500);
		osDelay(2000);
		aqmd_set_pwm(0x01, 0);
		osDelay(500);
		
//		aqmd_debug_log();
//		osDelay(200);
	}
}
























